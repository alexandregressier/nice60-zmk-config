## config/west.yml
```yaml
manifest:
  defaults:
    revision: main

  remotes:
    - name: urob
      url-base: https://github.com/urob
    - name: zmkfirmware
      url-base: https://github.com/zmkfirmware

  projects:
    - name: zmk
      remote: zmkfirmware
      import: app/west.yml

    # ZMK modules
    - name: zmk-adaptive-key
      remote: urob
      path: modules/zmk/adaptive-key
    - name: zmk-auto-layer
      remote: urob
      path: modules/zmk/auto-layer
    - name: zmk-helpers
      remote: urob
      path: modules/zmk/helpers
    - name: zmk-tri-state
      remote: urob
      path: modules/zmk/tri-state

  self:
    path: config
```
